## conf/layer.conf
```bitbake
# ---------------------------------------------------------------------------------------------------------------------
# SPDX-License-Identifier: MIT
# ---------------------------------------------------------------------------------------------------------------------

# We have a conf and classes directory, add to BBPATH
BBPATH ?= ""
BBPATH .= ":${LAYERDIR}"

# We have a packages directory, add to BBFILES
BBFILES += "${LAYERDIR}/recipes-*/*/*.bb \
            ${LAYERDIR}/recipes-*/*/*.bbappend"

# Let us add layer-specific bbappends which are only applied when that
# layer is included in our configuration
BBFILES += "${@' '.join('${LAYERDIR}/%s/recipes*/*/*.bbappend' % layer \
               for layer in BBFILE_COLLECTIONS.split())}"

BBFILE_COLLECTIONS += "tracing-layer"
BBFILE_PATTERN_tracing-layer = "^${LAYERDIR}/"
BBFILE_PATTERN_IGNORE_EMPTY_tracing-layer = "1"
BBFILE_PRIORITY_tracing-layer = "1"

LAYERSERIES_COMPAT_tracing-layer = "dunfell"

INHERIT_append = " feature_overrides"
FEATUREOVERRIDES .= "${@bb.utils.contains('USER_FEATURES', 'tracing', ':feature-tracing', '', d)}"
```
